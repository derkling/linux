## drivers/gpu/drm/mediatek/Kconfig
```kconfig
config DRM_MEDIATEK
	tristate "DRM Support for Mediatek SoCs"
	depends on DRM
	depends on ARCH_MEDIATEK || (ARM && COMPILE_TEST)
	select MTK_SMI
	select DRM_PANEL
	select DRM_MIPI_DSI
	select DRM_PANEL_SIMPLE
	select DRM_KMS_HELPER
	select IOMMU_DMA
	help
	  Choose this option if you have a Mediatek SoCs.
	  The module will be called mediatek-drm
	  This driver provides kernel mode setting and
	  buffer management to userspace.
```

## drivers/pci/host/Kconfig
```kconfig
menu "Generic PCI Host Bridge Support"
	depends on PCI

config PCI_HOST_XR3
	bool "XpressRICH 3 PCI Host Bridge"
	depends on PCI && ARM64
	help
	  XpressRICH3-AXI PCI Host Bridge

endmenu
```

## drivers/soc/mediatek/Kconfig
```kconfig
#
# MediaTek SoC drivers
#
config MTK_INFRACFG
	bool "MediaTek INFRACFG Support"
	depends on ARCH_MEDIATEK
	select REGMAP
	help
	  Say yes here to add support for the MediaTek INFRACFG controller. The
	  INFRACFG controller contains various infrastructure registers not
	  directly associated to any device.

config MTK_PMIC_WRAP
	tristate "MediaTek PMIC Wrapper Support"
	depends on ARCH_MEDIATEK
	select REGMAP
	help
	  Say yes here to add support for MediaTek PMIC Wrapper found
	  on different MediaTek SoCs. The PMIC wrapper is a proprietary
	  hardware to connect the PMIC.

config MTK_SCPSYS
	bool "MediaTek SCPSYS Support"
	depends on ARCH_MEDIATEK || COMPILE_TEST
	select REGMAP
	select MTK_INFRACFG
	help
	  Say yes here to add support for the MediaTek SCPSYS power domain
	  driver.

config MTK_SMI
        bool
	help
	  Smi help enable/disable iommu in mt8173 and control the
	  clock of each local arbiter.
	  It should be true while MTK_IOMMU enable.
```

## sound/soc/elba/Kconfig
```kconfig
config SND_ELBA_I2S
	tristate "SoC Audio for the Elba"
	help
	  Say Y or M if you want to add support for Elba
```

## sound/soc/mediatek/Kconfig
```kconfig
config SND_SOC_MEDIATEK
	bool "ASoC support for Mediatek chip"
	depends on ARCH_MEDIATEK
	help
	  This adds ASoC platform driver support for Mediatek chip
	  that can be used with other codecs.
	  Select Y if you have such device.
	  Ex: MT8173

config SND_SOC_MT8173_RT5650_RT5676
	bool "ASoC Audio driver for MT8173 with RT5650 RT5676 codecs"
	depends on ARCH_MEDIATEK
	select SND_SOC_MEDIATEK
	select SND_SOC_RT5645
	select SND_SOC_RT5677
	help
	  This adds ASoC driver for Mediatek MT8173 boards
	  with the RT5650 and RT5676 codecs.
	  Select Y if you have such device.
	  If unsure select "N".
```
