## Documentation/devicetree/bindings/arm/cpu-capacity.txt
```
==========================================
ARM CPUs capacity bindings
==========================================

==========================================
1 - Introduction
==========================================

ARM systems may be configured to have cpus with different power/performance
characteristics within the same chip. In this case, additional information
has to be made available to the kernel (the scheduler in particular) for
it to be aware of such differences and take decisions accordingly.

==========================================
2 - CPU capacity definition
==========================================

CPU capacity is a [1..1024] number that provides the scheduler information
about CPUs heterogeneity. Such heterogeneity can come from micro-architectural
differences (e.g., ARM big.LITTLE systems) or maximum frequency at which CPUs
can run (e.g., SMP systems with multiple frequency domains).

Unfortunately, there is NOT a unique way to precisely define how to come up
with CPU capacity values; they are truly benchmark dependent.  However, good
news is that such a precise definition isn't usually required in practice, as
benefits that come from having even approximates values are way better off than
leaving the scheduler unaware of any differences at all (default behaviour).

One simple way to estimate CPU capacities is to iteratively run a well-known
CPU user space benchmark (e.g, sysbench, dhrystone, etc.) on each CPU at
maximum frequency and then normalize values w.r.t.  the best performing CPU.
One can also do a statistically significant study of a wide collection of
benchmarks, but pros of such an approach are not really evident at the time of
writing.

==========================================
3 - cpu-capacities node
==========================================

CPUs capacities are defined within the cpu-capacities node, which is a direct
child of the cpus node [1] and provides a container where capacities of the
system's CPUs, defined as device tree nodes, are listed.

- cpu-capacities node

	Usage: Optional - On ARM systems, it is a container of CPUs capacities.
			  If CPUs all have the same capacity an cpu-capacities
			  node is not required.

	Description: cpu-capacities node is a container node, where its
		     subnodes describe the CPU capacity.

	Node name must be "cpu-capacities".

	The cpu-capacities node's parent must be the cpus node.

	The cpu-capacities node's child nodes can be:

	- one or more capacity nodes

	Any other configuration is considered invalid.

==========================================
4 - capacity node
==========================================

	Description: must be child of the cpu-capacities node.

	The following item represents the single valid property for a capacity
        node.

	- capacity
		Usage: required
		Value type: <prop-encoded-array>
		Definition: u32 value represeting CPU capacity (refer to
			    setion 2 of this document for a complete
			    description).

===========================================
5 - Examples
===========================================

Example 1 (ARM 64-bit, 6-cpu system, two clusters):

cpus {
	#address-cells = <2>;
	#size-cells = <0>;

	cpu-map {
		cluster0 {
			core0 {
				cpu = <&A57_0>;
			};
			core1 {
				cpu = <&A57_1>;
			};
		};

		cluster1 {
			core0 {
				cpu = <&A53_0>;
			};
			core1 {
				cpu = <&A53_1>;
			};
			core2 {
				cpu = <&A53_2>;
			};
			core3 {
				cpu = <&A53_3>;
			};
		};
	};

	idle-states {
		entry-method = "arm,psci";

		CPU_SLEEP_0: cpu-sleep-0 {
			compatible = "arm,idle-state";
			arm,psci-suspend-param = <0x0010000>;
			local-timer-stop;
			entry-latency-us = <100>;
			exit-latency-us = <250>;
			min-residency-us = <150>;
		};

		CLUSTER_SLEEP_0: cluster-sleep-0 {
			compatible = "arm,idle-state";
			arm,psci-suspend-param = <0x1010000>;
			local-timer-stop;
			entry-latency-us = <800>;
			exit-latency-us = <700>;
			min-residency-us = <2500>;
		};
	};

	cpu-capacities {
		CPU_CAP_BIG: cpu-cap-big {
			capacity = <1024>;
		};

		CPU_CAP_LITTLE: cpu-cap-little {
			capacity = <447>;
		};
	};

	A57_0: cpu@0 {
		compatible = "arm,cortex-a57","arm,armv8";
		reg = <0x0 0x0>;
		device_type = "cpu";
		enable-method = "psci";
		next-level-cache = <&A57_L2>;
		clocks = <&scpi_dvfs 0>;
		cpu-idle-states = <&CPU_SLEEP_0 &CLUSTER_SLEEP_0>;
		capacity = <&CPU_CAP_BIG>;
	};

	A57_1: cpu@1 {
		compatible = "arm,cortex-a57","arm,armv8";
		reg = <0x0 0x1>;
		device_type = "cpu";
		enable-method = "psci";
		next-level-cache = <&A57_L2>;
		clocks = <&scpi_dvfs 0>;
		cpu-idle-states = <&CPU_SLEEP_0 &CLUSTER_SLEEP_0>;
		capacity = <&CPU_CAP_BIG>;
	};

	A53_0: cpu@100 {
		compatible = "arm,cortex-a53","arm,armv8";
		reg = <0x0 0x100>;
		device_type = "cpu";
		enable-method = "psci";
		next-level-cache = <&A53_L2>;
		clocks = <&scpi_dvfs 1>;
		cpu-idle-states = <&CPU_SLEEP_0 &CLUSTER_SLEEP_0>;
		capacity = <&CPU_CAP_LITTLE>;
	};

	A53_1: cpu@101 {
		compatible = "arm,cortex-a53","arm,armv8";
		reg = <0x0 0x101>;
		device_type = "cpu";
		enable-method = "psci";
		next-level-cache = <&A53_L2>;
		clocks = <&scpi_dvfs 1>;
		cpu-idle-states = <&CPU_SLEEP_0 &CLUSTER_SLEEP_0>;
		capacity = <&CPU_CAP_LITTLE>;
	};

	A53_2: cpu@102 {
		compatible = "arm,cortex-a53","arm,armv8";
		reg = <0x0 0x102>;
		device_type = "cpu";
		enable-method = "psci";
		next-level-cache = <&A53_L2>;
		clocks = <&scpi_dvfs 1>;
		cpu-idle-states = <&CPU_SLEEP_0 &CLUSTER_SLEEP_0>;
		capacity = <&CPU_CAP_LITTLE>;
	};

	A53_3: cpu@103 {
		compatible = "arm,cortex-a53","arm,armv8";
		reg = <0x0 0x103>;
		device_type = "cpu";
		enable-method = "psci";
		next-level-cache = <&A53_L2>;
		clocks = <&scpi_dvfs 1>;
		cpu-idle-states = <&CPU_SLEEP_0 &CLUSTER_SLEEP_0>;
		capacity = <&CPU_CAP_LITTLE>;
	};

	A57_L2: l2-cache0 {
		compatible = "cache";
	};

	A53_L2: l2-cache1 {
		compatible = "cache";
	};
};

Example 2 (ARM 32-bit, 5-cpu system, two clusters):

cpus {
	#address-cells = <1>;
	#size-cells = <0>;

	cpu0: cpu@0 {
		device_type = "cpu";
		compatible = "arm,cortex-a15";
		reg = <0>;
		cci-control-port = <&cci_control1>;
		cpu-idle-states = <&CLUSTER_SLEEP_BIG>;
		capacity = <&CPU_CAP_BIG>;
	};

	cpu1: cpu@1 {
		device_type = "cpu";
		compatible = "arm,cortex-a15";
		reg = <1>;
		cci-control-port = <&cci_control1>;
		cpu-idle-states = <&CLUSTER_SLEEP_BIG>;
		capacity = <&CPU_CAP_BIG>;
	};

	cpu2: cpu@2 {
		device_type = "cpu";
		compatible = "arm,cortex-a7";
		reg = <0x100>;
		cci-control-port = <&cci_control2>;
		cpu-idle-states = <&CLUSTER_SLEEP_LITTLE>;
		capacity = <&CPU_CAP_LITTLE>;
	};

	cpu3: cpu@3 {
		device_type = "cpu";
		compatible = "arm,cortex-a7";
		reg = <0x101>;
		cci-control-port = <&cci_control2>;
		cpu-idle-states = <&CLUSTER_SLEEP_LITTLE>;
		capacity = <&CPU_CAP_LITTLE>;
	};

	cpu4: cpu@4 {
		device_type = "cpu";
		compatible = "arm,cortex-a7";
		reg = <0x102>;
		cci-control-port = <&cci_control2>;
		cpu-idle-states = <&CLUSTER_SLEEP_LITTLE>;
		capacity = <&CPU_CAP_LITTLE>;
	};

	idle-states {
		CLUSTER_SLEEP_BIG: cluster-sleep-big {
			compatible = "arm,idle-state";
			local-timer-stop;
			entry-latency-us = <1000>;
			exit-latency-us = <700>;
			min-residency-us = <2000>;
		};

		CLUSTER_SLEEP_LITTLE: cluster-sleep-little {
			compatible = "arm,idle-state";
			local-timer-stop;
			entry-latency-us = <1000>;
			exit-latency-us = <500>;
			min-residency-us = <2500>;
		};
	};

	cpu-capacities {
		CPU_CAP_BIG: cpu-cap-big {
			capacity = <1024>;
		};
		CPU_CAP_LITTLE: cpu-cap-little {
			capacity = <430>;
		};
	};
};

===========================================
6 - References
===========================================

[1] ARM Linux Kernel documentation - CPUs bindings
    Documentation/devicetree/bindings/arm/cpus.txt
```

## Documentation/devicetree/bindings/arm/gic.txt
```
* ARM Generic Interrupt Controller

ARM SMP cores are often associated with a GIC, providing per processor
interrupts (PPI), shared processor interrupts (SPI) and software
generated interrupts (SGI).

Primary GIC is attached directly to the CPU and typically has PPIs and SGIs.
Secondary GICs are cascaded into the upward interrupt controller and do not
have PPIs or SGIs.

Main node required properties:

- compatible : should be one of:
	"arm,cortex-a9-gic"
	"arm,arm11mp-gic"
- interrupt-controller : Identifies the node as an interrupt controller
- #interrupt-cells : Specifies the number of cells needed to encode an
  interrupt source.  The type shall be a <u32> and the value shall be 3.

  The 1st cell is the interrupt type; 0 for SPI interrupts, 1 for PPI
  interrupts.

  The 2nd cell contains the interrupt number for the interrupt type.
  SPI interrupts are in the range [0-987].  PPI interrupts are in the
  range [0-15].

  The 3rd cell is the flags, encoded as follows:
	bits[3:0] trigger type and level flags.
		1 = low-to-high edge triggered
		2 = high-to-low edge triggered
		4 = active high level-sensitive
		8 = active low level-sensitive
	bits[15:8] PPI interrupt cpu mask.  Each bit corresponds to each of
	the 8 possible cpus attached to the GIC.  A bit set to '1' indicated
	the interrupt is wired to that CPU.  Only valid for PPI interrupts.

- reg : Specifies base physical address(s) and size of the GIC registers. The
  first region is the GIC distributor register base and size. The 2nd region is
  the GIC cpu interface register base and size.

Optional
- interrupts	: Interrupt source of the parent interrupt controller. Only
  present on secondary GICs.

- cpu-offset	: per-cpu offset within the distributor and cpu interface
  regions, used when the GIC doesn't have banked registers. The offset is
  cpu-offset * cpu-nr.

Example:

	intc: interrupt-controller@fff11000 {
		compatible = "arm,cortex-a9-gic";
		#interrupt-cells = <3>;
		#address-cells = <1>;
		interrupt-controller;
		reg = <0xfff11000 0x1000>,
		      <0xfff10100 0x100>;
	};

* ARM Generic Interrupt Controller CPU Interfaces

ARM GIC device tree nodes contain subnodes representing its CPU interfaces.

The main properties required by CPU interface nodes are:

- compatible	: "arm,gic-cpuif"
- cpuif-id	: specifies the CPU IF HW identifier
- cpu		: a phandle to the respective CPU node

Example:

	cpus {
		#size-cells = <0>;
		#address-cells = <1>;

		CPU0: cpu@0x0 {
			device_type = "cpu";
			reg = <0x0>;
		};

		CPU1: cpu@0x1 {
			device_type = "cpu";
			reg = <0x1>;
		};

		CPU2: cpu@0x100 {
			device_type = "cpu";
			reg = <0x100>;
		};

		CPU3: cpu@0x101 {
			device_type = "cpu";
			reg = <0x101>;
		};
	};

	intc: interrupt-controller@fff11000 {
		compatible = "arm,cortex-a9-gic";
		#interrupt-cells = <3>;
		#address-cells = <1>;
		interrupt-controller;
		reg = <0xfff11000 0x1000>,
		      <0xfff10100 0x100>;

			gic-cpuif@0x0 {
				compatible = "arm,gic-cpuif";
				cpuif-id = <0x0>;
				cpu = <&CPU0>;
			};

			gic-cpuif@0x1 {
				compatible = "arm,gic-cpuif";
				cpuif-id = <0x1>;
				cpu = <&CPU1>;
			};

			gic-cpuif@0x2 {
				compatible = "arm,gic-cpuif";
				cpuif-id = <0x2>;
				cpu = <&CPU2>;
			};

			gic-cpuif@0x3 {
				compatible = "arm,gic-cpuif";
				cpuif-id = <0x3>;
				cpu = <&CPU3>;
			};
	};
```

## Documentation/devicetree/bindings/arm/system-suspend.txt
```
==========================================
ARM system suspend binding description
==========================================

==========================================
1 - Introduction
==========================================

System Suspend(commonly known as Suspend to RAM) is a method to remove
power from most parts of the machine aside from the RAM, which is required
to restore the machine's state. Because of the large power savings, it is
widely used in mobile systems like laptops, tablets and smartphones.

Usually most mobile systems enter system suspend state aggressively when
they are idle even for short time(in seconds) while others systems like
laptops automatically enter this mode when they running on batteries and
the lid is closed (and/or the user is inactive for some time(in minutes)).

Most of the devices in the system are deactivated. Non-volatile memory
(like disk drives, flash, memory card), graphics chips and even the CPU
are usually deactivated. Only the RAM is powered to keep its contents. On
resume, only those individual devices/CPUs need to be reinitialized and
work continues relatively fast.

It is highly hardware specific especially on ARM platforms. Hence we need
device tree binding definition for ARM system suspend state which is the
subject of this document in order to provide generic solution.

===========================================
2 - system suspend node
===========================================

The system suspend node represents the description of the mechanism to
enter system suspend state and must be defined as follows:

	- compatible
		Usage: Required
		Value type: <stringlist>
		Definition: Must be "arm,system-suspend";

	- entry-method
		Value type: <stringlist>
		Usage and definition depend on ARM architecture version.
			# On ARM v8 64-bit this property is required and must
			  be one of:
			   - "arm,psci" (see bindings in [1])

	- status:
		Usage: Optional
		Value type: <string>
		Definition: A standard device tree property [2] that indicates
			    the operational status of system suspend.
			    If present, it shall be:
			    "okay": to indicate it is operational.
			    "disabled": to indicate that it has been disabled
			                in firmware so it is not operational.
			    By default, it's always enabled if not explicitly
			    disabled.

	In addition to the properties listed above, it may require additional
	properties specifics to the entry-method defined, please refer to the
	corresponding entry-method bindings documentation for details.
	In the below example using "arm,psci" entry method,
	"arm,psci-suspend-param" is a PSCI specific property.

	The system suspend node's parent node must be the 'cpus' node.

===========================================
3 - Examples
===========================================

Example:
cpus {
	/* cpu-map, cpu and idle-states nodes */
	....

	system-suspend {
		compatible = "arm,system-suspend";
		entry-method = "arm,psci";
		arm,psci-suspend-param = <0x1010000>;
	};

	....
};
===========================================
4 - References
===========================================

[1] ARM Linux Kernel documentation - PSCI bindings
    Documentation/devicetree/bindings/arm/psci.txt

[2] ePAPR standard
    https://www.power.org/documentation/epapr-version-1-1/
```
