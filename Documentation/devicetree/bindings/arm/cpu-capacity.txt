## Documentation/devicetree/bindings/cpufreq/cpufreq-mt8173.txt
```
Mediatek MT8173 cpufreq driver
------------------------------

Mediatek MT8173 cpufreq driver for CPU frequency scaling.

Required properties:
- clocks: A list of phandle + clock-specifier pairs for the clocks listed in clock names.
- clock-names: Should contain the following:
	"cpu"		- The multiplexer for clock input of CPU cluster.
	"intermediate"	- A parent of "cpu" clock which is used as "intermediate" clock
			  source (usually MAINPLL) when the original CPU PLL is under
			  transition and not stable yet.
	Please refer to Documentation/devicetree/bindings/clk/clock-bindings.txt for
	generic clock consumer properties.
- operating-points: Please refer to Documentation/devicetree/bindings/power/opp.txt for
		    details.
- proc-supply: Regulator for Vproc of CPU cluster.

Optional properties:
- sram-supply: Regulator for Vsram of CPU cluster. When present, the cpufreq driver
	       needs to do "voltage trace" to step by step scale up/down Vproc and
	       Vsram to fit SoC specific needs. When absent, the voltage scaling
	       flow is handled by hardware, hence no software "voltage trace" is
	       needed.
- #cooling-cells:
- cooling-min-level:
- cooling-max-level:
	Please refer to Documentation/devicetree/bindings/thermal/thermal.txt.

Example:
--------
	cpu0: cpu@0 {
		device_type = "cpu";
		compatible = "arm,cortex-a53";
		reg = <0x000>;
		enable-method = "psci";
		cpu-idle-states = <&CPU_SLEEP_0>;
		clocks = <&infracfg CLK_INFRA_CA53SEL>,
			 <&apmixedsys CLK_APMIXED_MAINPLL>;
		clock-names = "cpu", "intermediate";
		operating-points = <
			507000	859000
			702000	908000
			1001000	983000
			1105000	1009000
			1183000	1028000
			1404000	1083000
			1508000	1109000
			1573000	1125000
		>;
		#cooling-cells = <2>;
		cooling-min-level = <0>;
		cooling-max-level = <7>;
	};

	cpu1: cpu@1 {
		device_type = "cpu";
		compatible = "arm,cortex-a53";
		reg = <0x001>;
		enable-method = "psci";
		cpu-idle-states = <&CPU_SLEEP_0>;
		clocks = <&infracfg CLK_INFRA_CA53SEL>,
			 <&apmixedsys CLK_APMIXED_MAINPLL>;
		clock-names = "cpu", "intermediate";
		operating-points = <
			507000	859000
			702000	908000
			1001000	983000
			1105000	1009000
			1183000	1028000
			1404000	1083000
			1508000	1109000
			1573000	1125000
		>;
		#cooling-cells = <2>;
		cooling-min-level = <0>;
		cooling-max-level = <7>;
	};

	cpu2: cpu@100 {
		device_type = "cpu";
		compatible = "arm,cortex-a57";
		reg = <0x100>;
		enable-method = "psci";
		cpu-idle-states = <&CPU_SLEEP_0>;
		clocks = <&infracfg CLK_INFRA_CA57SEL>,
			 <&apmixedsys CLK_APMIXED_MAINPLL>;
		clock-names = "cpu", "intermediate";
		operating-points = <
			507000	828000
			702000	867000
			1001000	927000
			1209000	968000
			1404000	1007000
			1612000	1049000
			1807000	1089000
			1989000	1125000
		>;
		#cooling-cells = <2>;
		cooling-min-level = <0>;
		cooling-max-level = <7>;
	};

	cpu3: cpu@101 {
		device_type = "cpu";
		compatible = "arm,cortex-a57";
		reg = <0x101>;
		enable-method = "psci";
		cpu-idle-states = <&CPU_SLEEP_0>;
		clocks = <&infracfg CLK_INFRA_CA57SEL>,
			 <&apmixedsys CLK_APMIXED_MAINPLL>;
		clock-names = "cpu", "intermediate";
		operating-points = <
			507000	828000
			702000	867000
			1001000	927000
			1209000	968000
			1404000	1007000
			1612000	1049000
			1807000	1089000
			1989000	1125000
		>;
		#cooling-cells = <2>;
		cooling-min-level = <0>;
		cooling-max-level = <7>;
	};

	&cpu0 {
		proc-supply = <&mt6397_vpca15_reg>;
	};

	&cpu1 {
		proc-supply = <&mt6397_vpca15_reg>;
	};

	&cpu2 {
		proc-supply = <&da9211_vcpu_reg>;
		sram-supply = <&mt6397_vsramca7_reg>;
	};

	&cpu3 {
		proc-supply = <&da9211_vcpu_reg>;
		sram-supply = <&mt6397_vsramca7_reg>;
	};
```

## Documentation/devicetree/bindings/phy/phy-hi3660-usb3.txt
```
Hisilicon hi3660 USB PHY
-----------------------

Required properties:
- compatible: should be "hisilicon,hi3660-usb-phy"
- #phy-cells: must be 0
- hisilicon,pericrg-syscon: phandle of syscon used to control phy.
- hisilicon,pctrl-syscon: phandle of syscon used to control phy.
- hisilicon,usb3-otg-bc-syscon: phandle of syscon used to control phy.
- hisilicon,eye-diagram-param: parameter set for phy
Refer to phy/phy-bindings.txt for the generic PHY binding properties

Example:
	usb-phy {
		compatible = "hisilicon,hi3660-usb-phy";
		#phy-cells = <0>;
		hisilicon,pericrg-syscon = <&crg_ctrl>;
		hisilicon,pctrl-syscon = <&pctrl>;
		hisilicon,usb3-otg-bc-syscon = <&usb3_otg_bc>;
		hisilicon,eye-diagram-param = <0x22466e4>;
	};
```

## Documentation/devicetree/bindings/regulator/mt6311-regulator.txt
```
Mediatek MT6311 Regulator Driver

Required properties:
- compatible: "mediatek,mt6311-regulator"
- mt6311regulator: List of regulators provided by this controller. It is named
  to VDVFS and VBIASN.
  The definition for each of these nodes is defined using the standard binding
  for regulators at Documentation/devicetree/bindings/regulator/regulator.txt.

The valid names for regulators are:
BUCK:
  VDVFS
LDO:
  VBIASN

Example:
	pmic: mt6311@6B {
		compatible = "mediatek,mt6311-regulator";
		reg = <0x6B>;

		regulators {
			mt6311_vcpu_reg: VDVFS {
				regulator-name = "VDVFS";
				regulator-min-microvolt = < 600000>;
				regulator-max-microvolt = <1400000>;
				regulator-ramp-delay = <10000>;
			};
			mt6311_ldo_reg: VBIASN {
				regulator-name = "VBIASN";
				regulator-min-microvolt = <200000>;
				regulator-max-microvolt = <800000>;
			};
		};
	};
```

## Documentation/devicetree/bindings/soc/mediatek/mediatek,smi-larb.txt
```
SMI(Smart Multimedia Interface) Local Arbiter

The hardware block diagram please check bindings/iommu/mediatek,iommu.txt

Required properties:
- compatible : must be "mediatek,mt8173-smi-larb"
- reg : the register and size of this local arbiter.
- smi : a phandle to the smi_common node.
- clocks : Must contain an entry for each entry in clock-names.
- clock-names: must contain 2 entries, as follows:
  - "apb" : Advanced Peripheral Bus clock, It's the clock for setting
	    the register.
  - "smi" : It's the clock for transfer data and command.

Example:
	larb0:larb@14021000 {
		compatible = "mediatek,mt8173-smi-larb";
		reg = <0 0x14021000 0 0x1000>;
		smi = <&smi_common>;
		clocks = <&mmsys MM_SMI_LARB0>,
			 <&mmsys MM_SMI_LARB0>;
		clock-names = "apb", "smi";
	};
```

## Documentation/devicetree/bindings/sound/mt8173-max98090.txt
```
MT8173 with MAX98090 CODEC

Required properties:
- compatible : "mediatek,mt8173-max98090"
- mediatek,audio-codec: the phandle of the MAX98090 audio codec
- dvdd-supply : the phandle of regulator to supply 1.2V
- avdd-supply : the phandle of regulator to supply 1.8V

Example:

	sound {
		compatible = "mediatek,mt8173-max98090";
		mediatek,audio-codec = <&max98090>;
		dvdd-supply = <&mt6397_vgp1_reg>;
		avdd-supply = <&mt6397_vgp4_reg>;
	};
```

## Documentation/devicetree/bindings/sound/mt8173-rt5650-rt5676.txt
```
MT8173 with RT5650 RT5676 CODECS

Required properties:
- compatible : "mediatek,mt8173-rt5650-rt5676"
- mediatek,audio-codec: the phandles of rt5650 and rt5676 codecs
- avdd-supply : the phandle of regulator to supply 1.8V

Example:

	sound {
		compatible = "mediatek,mt8173-rt5650-rt5676";
		mediatek,audio-codec = <&rt5650 &rt5676>;
		avdd-supply = <&mt6397_vgp1_reg>;
	};
```

## Documentation/devicetree/bindings/thermal/arm-pvt.txt
```
* ARM PVT Thermal Sensor

** Node properties:

- compatible : "arm,arm-pvt";
- reg : address range of the pvt sensor registers;
- trip-pointN : optional sub-node describing the Nth trip point. It has the
  following mandatory properties -
	- temp : trip temperature in milliCelsius
	- type : trip point type, should be one of "active", "passive", "hot"
	or "critical"
  Trip point can also optionally define the following sub-node -
	- cdevM : defines a cpu frequency based Mth cooling device with the following
	mandatory property -
		- cluster : phandle of the cluster this cooling device will control

Example:
arm_pvt@7fff0300 {
	compatible = "arm,arm-pvt";
	reg = <0 0x7fff0300 0 0x001c>;

	trip-point0 {
		temp = <40000>;
		type = "active";
		cdev0 {
			cluster = <&cluster0>;
		};
		cdev1 {
			cluster = <&cluster1>;
		};
	};
	trip-point1 {
		temp = <55000>;
		type = "critical";
	};
};
```

## Documentation/devicetree/bindings/usb/hisilicon-hikey-usb.txt
```
Support USB functionality of Hisilicon Hikey Platform
-----------------------------

Required properties:
- compatible: "hisilicon,gpio_hubv1","hisilicon,hikey960_usb"

Example
-----

	hisi_hikey_usb: hisi_hikey_usb {
		compatible = "hisilicon,hikey960_usb";
		typc_vbus_int_gpio,typec-gpios = <&gpio25 2 0>;
		typc_vbus_enable_val = <1>;
		otg_gpio = <&gpio25 6 0>;
		hub_vdd33_en_gpio = <&gpio5 6 0>;
		pinctrl-names = "default";
		pinctrl-0 = <&usbhub5734_pmx_func>;
	};
```

## Documentation/devicetree/bindings/usb/mt65xx-u3phy.txt
```
MT65xx U3PHY

The device node for Mediatek SOC usb3.0 phy

Required properties:
 - compatible : Should be "mediatek,mt8173-u3phy"
 - reg        : Offset and length of registers, the first is for mac domain,
	another for phy domain
 - power-domains: to enable usb's mtcmos
 - usb-wakeup-ctrl : to access usb wakeup control register
 - wakeup-src : 1: ip sleep wakeup mode; 2: line state wakeup mode; others
	means don't enable wakeup source of usb
 - u2port-num : number of usb2.0 ports to support which should be 1 or 2
 - clocks     : must support all clocks that phy need
 - clock-names: should be "wakeup_deb_p0", "wakeup_deb_p1" for wakeup
	debounce control clocks, and "u3phya_ref" for u3phya reference clock.

Example:

u3phy: usb-phy@11271000 {
	compatible = "mediatek,mt8173-u3phy";
	reg = <0 0x11271000 0 0x3000>,
	      <0 0x11280000 0 0x20000>;
	power-domains = <&scpsys MT8173_POWER_DOMAIN_USB>;
	usb-wakeup-ctrl = <&pericfg>;
	wakeup-src = <1>;
	u2port-num = <2>;
	clocks = <&perisys PERI_USB0>,
		 <&perisys PERI_USB1>,
		 <&apmixedsys CLK_APMIXED_REF2USB_TX>;
	clock-names = "wakeup_deb_p0",
		      "wakeup_deb_p1",
		      "u3phya_ref";
};
```

## Documentation/devicetree/bindings/usb/mt8173-xhci.txt
```
MT65XX xhci

The device node for Mediatek SOC usb3.0 host controller

Required properties:
 - compatible : supports "mediatek,mt8173-xhci"
 - reg        : Offset and length of registers
 - interrupts : Interrupt mode, number and trigger mode
 - reg-vusb33-supply:  regulator of usb avdd3.3v
 - reg-vbus-supply : regulator of vbus;
 - usb-phy : the phy that xhci will bind
 - usb3-lpm-capable: supports USB3 LPM
 - clocks     : must support all clocks that xhci needs
 - clock-names: should be "sys_mac" for sys and mac clocks

Example:
usb: usb30@11270000 {
	compatible = "mediatek,mt8173-xhci";
	reg = <0 0x11270000 0 0x1000>;
	interrupts = <GIC_SPI 115 IRQ_TYPE_LEVEL_LOW>;
	reg-vusb33-supply = <&mt6397_vusb_reg>;
	reg-vbus-supply = <&usb_p1_vbus>;
	usb-phy = <&u3phy>;
	usb3-lpm-capable;
	clocks = <&topckgen CLK_TOP_USB30_SEL>;
	clock-names = "sys_mac";
};
```

## arch/arm/configs/vexpress_defconfig
```kconfig
# CONFIG_LOCALVERSION_AUTO is not set
CONFIG_SYSVIPC=y
CONFIG_POSIX_MQUEUE=y
CONFIG_NO_HZ=y
CONFIG_HIGH_RES_TIMERS=y
CONFIG_BSD_PROCESS_ACCT=y
CONFIG_IKCONFIG=y
CONFIG_IKCONFIG_PROC=y
CONFIG_LOG_BUF_SHIFT=16
CONFIG_CGROUPS=y
CONFIG_BLK_DEV_INITRD=y
CONFIG_EMBEDDED=y
# CONFIG_COMPAT_BRK is not set
CONFIG_SLAB=y
CONFIG_PROFILING=y
CONFIG_OPROFILE=y
CONFIG_CC_STACKPROTECTOR_REGULAR=y
CONFIG_MODULES=y
CONFIG_MODULE_UNLOAD=y
CONFIG_ARCH_VEXPRESS=y
CONFIG_ARCH_VEXPRESS_DCSCB=y
CONFIG_ARCH_VEXPRESS_TC2_PM=y
CONFIG_SMP=y
CONFIG_SCHED_MC=y
CONFIG_SCHED_SMT=y
CONFIG_HAVE_ARM_ARCH_TIMER=y
CONFIG_BIG_LITTLE=y
CONFIG_NR_CPUS=8
CONFIG_ARM_PSCI=y
CONFIG_THUMB2_KERNEL=y
CONFIG_HIGHMEM=y
CONFIG_HIGHPTE=y
CONFIG_DEFAULT_MMAP_MIN_ADDR=32768
CONFIG_SECCOMP=y
CONFIG_CMDLINE="console=ttyAMA0,38400n8 root=/dev/mmcblk0p2 rootwait mmci.fmax=4000000"
CONFIG_CPU_FREQ=y
CONFIG_CPU_FREQ_GOV_USERSPACE=y
CONFIG_CPU_FREQ_GOV_ONDEMAND=y
CONFIG_CPUFREQ_DT=y
CONFIG_ARM_BIG_LITTLE_CPUFREQ=y
CONFIG_ARM_DT_BL_CPUFREQ=y
CONFIG_ARM_VEXPRESS_SPC_CPUFREQ=y
CONFIG_CPU_IDLE=y
CONFIG_ARM_BIG_LITTLE_CPUIDLE=y
CONFIG_VFP=y
CONFIG_NEON=y
CONFIG_BINFMT_MISC=y
CONFIG_NET=y
CONFIG_PACKET=y
CONFIG_UNIX=y
CONFIG_XFRM_USER=y
CONFIG_NET_KEY=y
CONFIG_NET_KEY_MIGRATE=y
CONFIG_INET=y
CONFIG_IP_MULTICAST=y
CONFIG_IP_PNP=y
CONFIG_IP_PNP_DHCP=y
CONFIG_IP_PNP_BOOTP=y
CONFIG_IP_PNP_RARP=y
CONFIG_SYN_COOKIES=y
# CONFIG_INET_LRO is not set
CONFIG_NETFILTER=y
CONFIG_NETFILTER_NETLINK_LOG=m
CONFIG_NF_CONNTRACK=m
CONFIG_NF_CT_NETLINK=m
CONFIG_NETFILTER_XT_MARK=m
CONFIG_NETFILTER_XT_TARGET_CHECKSUM=m
CONFIG_NETFILTER_XT_TARGET_LOG=m
CONFIG_NETFILTER_XT_TARGET_REDIRECT=m
CONFIG_NETFILTER_XT_MATCH_CONNMARK=m
CONFIG_NETFILTER_XT_MATCH_CONNTRACK=m
CONFIG_NETFILTER_XT_MATCH_LIMIT=m
CONFIG_NETFILTER_XT_MATCH_MAC=m
CONFIG_NETFILTER_XT_MATCH_MULTIPORT=m
CONFIG_NETFILTER_XT_MATCH_STATE=m
CONFIG_NF_CONNTRACK_IPV4=m
CONFIG_NF_NAT_IPV4=m
CONFIG_IP_NF_IPTABLES=m
CONFIG_IP_NF_FILTER=m
CONFIG_IP_NF_TARGET_REJECT=m
CONFIG_IP_NF_MANGLE=m
CONFIG_NF_CONNTRACK_IPV6=m
CONFIG_NF_NAT_IPV6=m
CONFIG_IP6_NF_IPTABLES=m
CONFIG_IP6_NF_FILTER=m
CONFIG_IP6_NF_TARGET_REJECT=m
CONFIG_IP6_NF_MANGLE=m
CONFIG_BRIDGE_NF_EBTABLES=m
CONFIG_BRIDGE_EBT_T_FILTER=m
CONFIG_BRIDGE_EBT_T_NAT=m
CONFIG_BRIDGE_EBT_MARK_T=m
CONFIG_BRIDGE=m
CONFIG_UEVENT_HELPER_PATH="/sbin/hotplug"
CONFIG_DEVTMPFS=y
CONFIG_DEVTMPFS_MOUNT=y
CONFIG_CONNECTOR=y
CONFIG_MTD=y
CONFIG_MTD_CMDLINE_PARTS=y
CONFIG_MTD_BLOCK=y
CONFIG_MTD_OOPS=y
CONFIG_MTD_CFI=y
CONFIG_MTD_CFI_INTELEXT=y
CONFIG_MTD_NAND=y
CONFIG_BLK_DEV_LOOP=y
CONFIG_BLK_DEV_RAM=y
CONFIG_BLK_DEV_RAM_SIZE=65536
CONFIG_VIRTIO_BLK=y
CONFIG_SCSI=y
CONFIG_BLK_DEV_SD=y
CONFIG_MD=y
CONFIG_BLK_DEV_DM=y
CONFIG_NETDEVICES=y
CONFIG_SMC91X=y
CONFIG_SMSC911X=y
CONFIG_INPUT_EVDEV=y
CONFIG_INPUT_MISC=y
CONFIG_INPUT_UINPUT=y
CONFIG_SERIO_AMBAKMI=y
# CONFIG_DEVKMEM is not set
CONFIG_SERIAL_AMBA_PL011=y
CONFIG_SERIAL_AMBA_PL011_CONSOLE=y
CONFIG_GPIO_SYSFS=y
CONFIG_SENSORS_VEXPRESS=y
CONFIG_REGULATOR_VEXPRESS=y
CONFIG_FB=y
CONFIG_FB_ARMCLCD=y
CONFIG_FB_ARMHDLCD=y
CONFIG_FRAMEBUFFER_CONSOLE=y
CONFIG_LOGO=y
# CONFIG_LOGO_LINUX_MONO is not set
# CONFIG_LOGO_LINUX_VGA16 is not set
CONFIG_SOUND=y
CONFIG_SND=y
CONFIG_SND_ARMAACI=y
CONFIG_USB=y
CONFIG_USB_ISP1760_HCD=y
CONFIG_USB_STORAGE=y
CONFIG_USB_ISP1760=y
CONFIG_MMC=y
CONFIG_MMC_ARMMMCI=y
CONFIG_NEW_LEDS=y
CONFIG_LEDS_CLASS=y
CONFIG_LEDS_GPIO=y
CONFIG_LEDS_TRIGGERS=y
CONFIG_LEDS_TRIGGER_HEARTBEAT=y
CONFIG_LEDS_TRIGGER_CPU=y
CONFIG_RTC_CLASS=y
CONFIG_RTC_DRV_PL031=y
CONFIG_VIRTIO_MMIO=y
CONFIG_VIRTIO_MMIO_CMDLINE_DEVICES=y
CONFIG_EXT2_FS=y
CONFIG_EXT3_FS=y
CONFIG_EXT3_FS_SECURITY=y
CONFIG_EXT4_FS=y
CONFIG_EXT4_FS_SECURITY=y
CONFIG_BTRFS_FS=y
CONFIG_QUOTA=y
CONFIG_QFMT_V2=y
CONFIG_AUTOFS4_FS=y
CONFIG_MSDOS_FS=y
CONFIG_VFAT_FS=y
CONFIG_TMPFS=y
CONFIG_TMPFS_POSIX_ACL=y
CONFIG_ECRYPT_FS=y
CONFIG_JFFS2_FS=y
CONFIG_JFFS2_SUMMARY=y
CONFIG_JFFS2_FS_XATTR=y
CONFIG_JFFS2_COMPRESSION_OPTIONS=y
CONFIG_JFFS2_LZO=y
CONFIG_JFFS2_RUBIN=y
CONFIG_CRAMFS=y
CONFIG_NFS_FS=y
# CONFIG_NFS_V2 is not set
CONFIG_NFS_V3_ACL=y
CONFIG_NFS_V4=y
CONFIG_ROOT_NFS=y
CONFIG_NLS_CODEPAGE_437=y
CONFIG_NLS_ISO8859_1=y
CONFIG_PRINTK_TIME=y
CONFIG_DEBUG_INFO=y
CONFIG_MAGIC_SYSRQ=y
CONFIG_SCHEDSTATS=y
CONFIG_TIMER_STATS=y
CONFIG_FUNCTION_TRACER=y
CONFIG_STRICT_DEVMEM=y
CONFIG_SECURITY=y
CONFIG_SECURITY_NETWORK_XFRM=y
CONFIG_LSM_MMAP_MIN_ADDR=0
CONFIG_SECURITY_SELINUX=y
CONFIG_SECURITY_SELINUX_BOOTPARAM=y
CONFIG_SECURITY_SELINUX_DISABLE=y
CONFIG_SECURITY_SMACK=y
CONFIG_SECURITY_APPARMOR=y
CONFIG_DEFAULT_SECURITY_APPARMOR=y
CONFIG_CRYPTO_MICHAEL_MIC=y
CONFIG_CRC_CCITT=y
CONFIG_CRC_T10DIF=y
CONFIG_CRC_ITU_T=y
CONFIG_CRC7=y
```
