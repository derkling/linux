## drivers/cpm/Kconfig
```kconfig
#
# CPM support
#


menuconfig CPM
	bool "CPM support"
	depends on EXPERIMENTAL
	default n
	help
	  CPM is a framework for Constrained Power Management.
	  This framework is an improvement over QoSPM and DPM, providing
	  support for feasible system configuration (FSC) identification,
	  and selection according to a choosed optimization policy and
	  run-time system constraints asserted by both kernel- and
	  user-land.

	  For details, take a look at <file:Documentation/cpu-freq>.

	  If in doubt, say N.

	  
if CPM

comment "Governors"

config CPM_GOV_EXHAUSTIVE
        tristate "\"Exhaustive\" governor"
	default m
        help
          The exhaustive is a CPM governor which provide FSC identification
	  using an exhaustive search among working regions (DWR) defined by
	  drivers registered to the framework

	  If in doubt, say M.

#choice
#	prompt "Default Governor"
#	default CPM_DEFAULT_GOVERNOR
#	help
#	  This option sets which CPM governor shall be loaded at
#	  startup. If in doubt, select 'performance'.
#
#config CPM_DEFAULT_GOV_EXHAUSTIVE
#	bool "exhaustive"
#	select CPM_GOV_EXHAUSTIVE
#	help
#	  Use the 'exhaustive' governor as default.
#
#endchoice


comment "Policies"

config CPM_POLICY_SAME
	tristate "\"Dummy\" policy"
	depends on CPM_TESTING 
	default n
	help
	  The "dummy" policy is a CPM policy used for testing
	  purpose only.

config CPM_POLICY_PERF
        tristate "\"Performance\" policy"
        help
          The "performance" policy is a CPM policy which allows to define
	  an optimization strategy by associating a weight to each system
	  metric (ASM) and using those values to identify a partial
	  ordering on FSC which is optimal with respect to the defined
	  strategy.

#choice
#	prompt "Default policy"
#	default CPM_DEFAULT_POLICY
#	help
#	  This option sets which CPM policy shall be loaded at
#	  startup. If in doubt, select 'performance'.
#
#config CPM_DEFAULT_POL_PERF
#	bool "performance"
#	select CPM_POLICY_PERF
#	help
#	  Use the 'performance' policy as default.
#
#endchoice


menuconfig CPM_DEBUG
	bool "Debug Support"
	default n
	help
	  Say Y here to enable CPM debugging code

if CPM_DEBUG

config CPM_GOVERNOR_DEBUG
	bool "Governors Debugging"
	default n
	help
	  Say Y here to enable CPM Governors debuggin code

config CPM_POLICY_DEBUG
	bool "Policies Debugging"
	default n
	help
	  Say Y here to enable CPM policies debugging code

endif

source "drivers/cpm/test/Kconfig"

endif # CPM
```

## drivers/cpm/test/Kconfig
```kconfig
#
# Testing CPM support
#

menuconfig CPM_TESTING
	bool "Testing support"
	default n
	help 
	  Say Y here to enable CPM testing code.
	  
if CPM_TESTING

config CPM_TEST_DUMMY
	tristate "Dummy test drivers"
	help
	  Say M to enable the generation of a dummy CPM test module.
	  This module allows to define an arbitrary number of platform devices
	  which are registered to CPM and can be used to test constraint
	  assertion and distribute agreement code.
	  
	  The module will be called cpm_test_dummy.ko
	  If in doubt, say M.

config CPM_TEST_BANDWIDTH
        tristate "Bandwidth use-case test driver"
        help
	  The module will be called cpm_test_bandwidth.ko
          If in doubt, say M.

config CPM_TEST_MP3GSM
        tristate "MP3-GSM alsa buffer use-case test driver" 
        help
	  The module will be called cpm_test_mp3gsm.ko
          If in doubt, say M.


endif # CPM_TESTING
```

## drivers/cpuidle/Kconfig
```kconfig
menu "CPU Idle"

config CPU_IDLE
	bool "CPU idle PM support"
	default y if ACPI || PPC_PSERIES
	select CPU_IDLE_GOV_LADDER if (!NO_HZ && !NO_HZ_IDLE)
	select CPU_IDLE_GOV_MENU if ((NO_HZ || NO_HZ_IDLE) && !CPU_IDLE_GOV_SCHEDULED)
	help
	  CPU idle is a generic framework for supporting software-controlled
	  idle processor power management.  It includes modular cross-platform
	  governors that can be swapped during runtime.

	  If you're using an ACPI-enabled platform, you should say Y here.

if CPU_IDLE

config CPU_IDLE_MULTIPLE_DRIVERS
        bool "Support multiple cpuidle drivers"
        default n
        help
         Allows the cpuidle framework to use different drivers for each CPU.
         This is useful if you have a system with different CPU latencies and
         states. If unsure say N.

config CPU_IDLE_GOV_LADDER
	bool "Ladder governor (for periodic timer tick)"
	default y

config CPU_IDLE_GOV_MENU
	bool "Menu governor (for tickless system)"
	select CPU_IDLE_GOV_SHARED_PREDICTOR
	select CPU_IDLE_GOV_SHARED_CSTATE_LOOKUP
	default y

if SMP
config CPU_IDLE_GOV_SCHEDULED
	bool "Scheduled governor"
	select CPU_IDLE_GOV_SHARED_PREDICTOR
	select CPU_IDLE_GOV_SHARED_CSTATE_LOOKUP
	default n
	help
	 A governor that selects an idle state based on timing constraints
	 set by another part of kernel. The state selection is recorded
	 in a variable visible to other parts of the kernel so all cores
	 may be considered when making scheduling decisions.
endif

config CPU_IDLE_GOV_SHARED_PREDICTOR
	def_bool n

config CPU_IDLE_GOV_SHARED_CSTATE_LOOKUP
	def_bool n

menu "ARM CPU Idle Drivers"
depends on ARM
source "drivers/cpuidle/Kconfig.arm"
endmenu

endif

config ARCH_NEEDS_CPU_IDLE_COUPLED
	def_bool n
endmenu
```

## drivers/gpu/drm/bridge/Kconfig
```kconfig
config DRM_PS8640
	bool "Enable PS8640 : MIPI to eDP Converter"
	depends on DRM
	select DRM_KMS_HELPER
	help
	  Choose this option if you have PS8640 for display
	  The PS8640 is a high-performance and low-power
	  MIPI to eDP converter

config DRM_PTN3460
	tristate "PTN3460 DP/LVDS bridge"
	depends on DRM
	select DRM_KMS_HELPER
	---help---
```
