/*
 * Copyright (c) 2014 MediaTek Inc.
 * Author: Eddie Huang <eddie.huang@mediatek.com>
 *
 * This program is free software; you can redistribute it and/or modify
 * it under the terms of the GNU General Public License version 2 as
 * published by the Free Software Foundation.
 *
 * This program is distributed in the hope that it will be useful,
 * but WITHOUT ANY WARRANTY; without even the implied warranty of
 * MERCHANTABILITY or FITNESS FOR A PARTICULAR PURPOSE.  See the
 * GNU General Public License for more details.
 */

/dts-v1/;
#include "mt8173-oak.dtsi"

/ {
	model = "Mediatek Oak rev1 board";
	compatible = "google,oak-rev1", "google,oak", "mediatek,mt8173";
};

&cpu2 {
	operating-points = <
		507000  828000
		702000  867000
		1001000 927000
		1209000 968000
		1404000 1007000
		1612000 1049000
	>;
};

&cpu3 {
	operating-points = <
		507000  828000
		702000  867000
		1001000 927000
		1209000 968000
		1404000 1007000
		1612000 1049000
	>;
};
