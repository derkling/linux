/*
 * ARM Ltd. Juno Platform
 *
 * Copyright (c) 2017 ARM Ltd.
 *
 * This file is licensed under a dual GPLv2 or BSD license.
 */

/dts-v1/;

#include "juno-r0.dtsi"
#include "juno-t62x.dtsi"

&gpu {
	system-coherency = <0>;
};
