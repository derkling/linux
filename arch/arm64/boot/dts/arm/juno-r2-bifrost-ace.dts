/*
 * ARM Ltd. Juno Platform
 *
 * Copyright (c) 2017 ARM Ltd.
 *
 * This file is licensed under a dual GPLv2 or BSD license.
 */

/dts-v1/;

#include "juno-r2.dtsi"
#include "juno-bifrost.dtsi"

&gpu {
	system-coherency = <1>;
	snoop_enable_smc=<0x8200ff04>;
	snoop_disable_smc = <0x8200ff05>;
};
