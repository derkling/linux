// ARM Ltd. Columbus Compute Subsystem

/dts-v1/;

/memreserve/ 0xbf000000 0x01000000;

/ {
	model = "ARM TestChip 2";
	compatible = "arm,columbus";
	interrupt-parent = <&gic>;
	#address-cells = <2>;
	#size-cells = <2>;

	aliases {
		serial0 = &v2m_serial0;
		arm,v2m_timer = &v2m_timer01;
	};
	
	chosen {
		bootargs = "console=ttyAMA0,38400 debug earlyprintk root=/dev/sda1 rootwait verbose rw";
	};

	clusters {
		#address-cells = <1>;
		#size-cells = <0>;

		cluster0: cluster@0 {
			reg = <0>;
			cores {
				#address-cells = <1>;
				#size-cells = <0>;

				core0: core@0 {
					reg = <0>;
				};

				core1: core@1 {
					reg = <1>;
				};

			};
		};

		cluster1: cluster@1 {
			reg = <1>;
			cores {
				#address-cells = <1>;
				#size-cells = <0>;

				core2: core@0 {
					reg = <0>;
				};

				core3: core@1 {
					reg = <1>;
				};

				core4: core@2 {
					reg = <2>;
				};
			};
		};
	};

	cpus {
		#address-cells = <1>;
		#size-cells = <0>;

		cpu0: cpu@0 {
			device_type = "cpu";
			compatible = "arm,cortex-a15";
			reg = <0>;
			cluster = <&cluster0>;
			core = <&core0>;
		};
		cpu1: cpu@1 {
			device_type = "cpu";
			compatible = "arm,cortex-a15";
			reg = <1>;
			cluster = <&cluster0>;
			core = <&core1>;
		};
		cpu2: cpu@2 {
			device_type = "cpu";
			compatible = "arm,cortex-a7";
			reg = <0x100>;
			cluster = <&cluster1>;
			core = <&core2>;
		};

		cpu3: cpu@3 {
			device_type = "cpu";
			compatible = "arm,cortex-a7";
			reg = <0x101>;
			cluster = <&cluster1>;
			core = <&core3>;
		};

		cpu4: cpu@4 {
			device_type = "cpu";
			compatible = "arm,cortex-a7";
			reg = <0x102>;
			cluster = <&cluster1>;
			core = <&core4>;
		};
	};

	memory {
		device_type = "memory";
		reg = <0x00 0x80000000 0x00 0x40000000>;
		//       0x08 0x80000000 0x07 0x80000000
		//       0x88 0x00000000 0x78 0x00000000>;
	};

	gic: interrupt-controller@2c001000 {
		compatible = "arm,cortex-a15-gic", "arm,cortex-a9-gic";
		interrupt-controller;
		#interrupt-cells = <3>;
		#address-cells = <0>;
		reg = <0x00 0x2c001000 0x0 0x1000>,
		      <0x00 0x2c002000 0x0 0x100>;

		gic-cpuif@0 {
			compatible = "arm,gic-cpuif";
			cpuif-id = <0>;
			cpu = <&cpu0>;
		};
		gic-cpuif@1 {
			compatible = "arm,gic-cpuif";
			cpuif-id = <1>;
			cpu = <&cpu1>;
		};
		gic-cpuif@2 {
			compatible = "arm,gic-cpuif";
			cpuif-id = <2>;
			cpu = <&cpu2>;
		};

		gic-cpuif@3 {
			compatible = "arm,gic-cpuif";
			cpuif-id = <3>;
			cpu = <&cpu3>;
		};

		gic-cpuif@4 {
			compatible = "arm,gic-cpuif";
			cpuif-id = <4>;
			cpu = <&cpu4>;
		};
	};

	localtimer {
		compatible = "arm,armv7-timer";
		interrupts = <1 13 0xff08  1 14 0xff08>;
		clock-frequency = <24000000>;
	};

	hdlcd@2b000000 {
		compatible = "arm,hdlcd";
		reg = <0x0 0x2b000000 0x0 0x1000>;
		interrupts = <0 85 4>;
		mode = "1680x1050-32@60";
		arm,vexpress-osc = <5>;
		framebuffer = <0x0 0xbf000000 0x0 0x01000000>;

	spc@2b000000 {
		compatible = "arm,spc";
		reg = <0x7FFF0000 0x1000>;
	};

	motherboard {
		ranges = <0 0 0x0 0x08000000 0x04000000>,
			 <1 0 0x0 0x14000000 0x04000000>,
			 <2 0 0x0 0x18000000 0x04000000>,
			 <3 0 0x0 0x1c000000 0x04000000>,
			 <4 0 0x0 0x0c000000 0x04000000>,
			 <5 0 0x0 0x10000000 0x04000000>;

		interrupt-map-mask = <0 0 127>;
		interrupt-map = <0 0  0 &gic 0  0 4>,
			        <0 0  1 &gic 0  1 4>,
			        <0 0  2 &gic 0  2 4>,
			        <0 0  3 &gic 0  3 4>,
			        <0 0  4 &gic 0  4 4>,
			        <0 0  5 &gic 0  5 4>,
			        <0 0  6 &gic 0  6 4>,
			        <0 0  7 &gic 0  7 4>,
			        <0 0  8 &gic 0  8 4>,
			        <0 0  9 &gic 0  9 4>,
			        <0 0 10 &gic 0 10 4>,
			        <0 0 11 &gic 0 11 4>,
			        <0 0 12 &gic 0 12 4>,
			        <0 0 13 &gic 0 13 4>,
			        <0 0 14 &gic 0 14 4>,
			        <0 0 15 &gic 0 15 4>,
			        <0 0 16 &gic 0 16 4>,
			        <0 0 17 &gic 0 17 4>,
			        <0 0 18 &gic 0 18 4>,
			        <0 0 19 &gic 0 19 4>,
			        <0 0 20 &gic 0 20 4>,
			        <0 0 21 &gic 0 21 4>,
			        <0 0 22 &gic 0 22 4>,
			        <0 0 23 &gic 0 23 4>,
			        <0 0 24 &gic 0 24 4>,
			        <0 0 25 &gic 0 25 4>,
			        <0 0 26 &gic 0 26 4>,
			        <0 0 27 &gic 0 27 4>,
			        <0 0 28 &gic 0 28 4>,
			        <0 0 29 &gic 0 29 4>,
			        <0 0 30 &gic 0 30 4>,
			        <0 0 31 &gic 0 31 4>,
			        <0 0 32 &gic 0 32 4>,
			        <0 0 33 &gic 0 33 4>,
			        <0 0 34 &gic 0 34 4>,
			        <0 0 35 &gic 0 35 4>,
			        <0 0 36 &gic 0 36 4>,
			        <0 0 37 &gic 0 37 4>,
			        <0 0 38 &gic 0 38 4>,
			        <0 0 39 &gic 0 39 4>,
			        <0 0 40 &gic 0 40 4>,
			        <0 0 41 &gic 0 41 4>,
			        <0 0 42 &gic 0 42 4>,
			        <0 0 66 &gic 0 66 4>,
			        <0 0 69 &gic 0 69 4>,
			        <0 0 73 &gic 0 73 4>,
			        <0 0 74 &gic 0 74 4>;
	};

};


/include/ "vexpress-v2m-rs1.dtsi"
